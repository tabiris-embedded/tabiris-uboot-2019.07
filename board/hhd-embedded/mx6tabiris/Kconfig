## board/hhd-embedded/mx6tabiris/Kconfig
```kconfig
if TARGET_MX6TABIRIS

config SYS_BOARD
	default "mx6tabiris"

config SYS_VENDOR
	default "hhd-embedded"

config SYS_CONFIG_NAME
	default "mx6tabiris"

endif
```
